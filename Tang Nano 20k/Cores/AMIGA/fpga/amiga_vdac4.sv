// SPDX-License-Identifier: GPL-3.0-or-later
// NanoMig A1200 logic, VDAC4 pins and host-loaded ROM. Generated by prepare.py.
`define ENABLE_TG68K
`define ENABLE_AGA
`define CPU_SLOW14
`define ENABLE_CACHE
`define CHIPRAM_CACHE
`define DENISE_EBR
`define DISABLE_IDE
`define DISABLE_ROM_LOADER
module amiga_vdac4
(
    input         clk_27m,
    input   [1:0]   btn,
    input  wire        link_sck,     
    input  wire        link_cs_n,    
    inout  wire [3:0]  link_io,      
    output tri         link_irq_n,   
    input  wire        cp_sck,       
    input  wire        cp_cs_n,      
    input  wire        cp_mosi,      
    output wire        cp_miso,      
    output wire        cp_irq_n,     
    output wire        mux_sel,      
    output wire        pa_en,        
    output wire        ft_int_n,     
    output wire        ft_miso,      
    input  wire [7:0]  mux_d,        
    input  wire        hsync_in,     
    input  wire        vsync_in,     
    input  wire        pclk_in,      
    input  wire        m_sel,        
    input  wire        ft_sck,       
    input  wire        ft_cs_n,      
    input  wire        ft_mosi,      
    output          O_sdram_clk,
    output          O_sdram_cke,
    output          O_sdram_cs_n,
    output          O_sdram_cas_n,
    output          O_sdram_ras_n,
    output          O_sdram_wen_n,
    output  [10:0]  O_sdram_addr,
    output  [1:0]   O_sdram_ba,
    output  [3:0]   O_sdram_dqm,
    inout   [31:0]  IO_sdram_dq,
    output        SD_SCK,
    output        SD_MOSI,
    input         SD_MISO,
    output        SD_CS,
    output            O_tmds_clk_p    ,
    output            O_tmds_clk_n    ,
    output     [2:0]  O_tmds_data_p   ,
    output     [2:0]  O_tmds_data_n
);
`default_nettype none
// HDMI clock:  141.8758 MHz
// Pixel clock: 28.37516 MHz (HDMI/5)
// SDRAM and flash clock: 85 MHz
// Amiga clock: 7.09379 (Pixel/4)
   
// 27MHz crystal * 19/6 = 85.5MHz, divided by 3. The nominal PAL clock would
// be 28.37516MHz, but this is the one the hardware actually runs at, and the
// audio rate below is derived from it.
`define PIXEL_CLOCK 28500000

wire clk_pixel_x5;   
wire pll_lock;   
wire clk_7;
wire clk_28m;
wire clk_85m;
wire clk_85m_shifted;
wire clk_pixel;

amigaclks amigaclks (
	.clk_in(clk_27m),
	.clk_7m(clk_7), // Unused
	.clk_28m(clk_28m),
	.clk_85m(clk_85m),
	.clk_sdram(clk_85m_shifted),
	.locked(pll_lock),
	.vidmode(1'b1),
	.clk_tmds(clk_pixel_x5),
	.clk_pixel(),
	.video_locked()
);

wire rst_28m, rst_28m_n;
wire rst_85m, rst_85m_n;
wire rst_sdram, rst_sdram_n;

wire sdram_ready;

rst_sync rst_sync (
  .clk_28m(clk_28m),
  .clk_85m(clk_85m),
  .pll_lock(pll_lock),
  .sdram_ready(sdram_ready),
  .rst_28m(rst_28m),
  .rst_28m_n(rst_28m_n),
  .rst_85m(rst_85m),
  .rst_85m_n(rst_85m_n),
  .rst_sdram(rst_sdram),
  .rst_sdram_n(rst_sdram_n)
);

wire	clk7_en;
wire	clk7n_en;


assign clk_pixel=clk_28m; // one pixel domain; serializer runs at 5x

assign mux_sel=0, pa_en=0, ft_int_n=1, ft_miso=0;
assign link_irq_n=1'bz;
wire [3:0] link_out; wire link_oe, boot_req, evo_reset, soft_reset;
assign link_io=link_oe ? link_out : 4'bzzzz;
next_evo_reset evo(.clk(clk_28m),.m_sel(m_sel),.req(evo_reset));
next_cp cp(.sck(cp_sck),.cs_n(cp_cs_n),.mosi(cp_mosi),.miso(cp_miso),
    .irq_n(cp_irq_n),.clk(clk_28m),.boot(boot_req | evo_reset));
wire rom_done, rom_write; wire [17:0] rom_address; wire [15:0] rom_value;
wire hid_strobe, hid_start, hid_reset; wire [7:0] hid_data, key_free;
wire [14:0] audio_left, audio_right;
wire [5:0] leds; wire fdd_step_n;
wire [1:0] osd_cpu=3, osd_chipmem=3, osd_slowmem=0, osd_fastmem=2;
wire [2:0] osd_chipset=6, osd_turbo=2, osd_volume=4;
wire [1:0] osd_floppy_drives=0, osd_video_filter=0, osd_video_scanlines=0, osd_video_screen=0;
wire osd_video_mode=0, osd_floppy_wrprot=1, osd_floppy_turbo=0, osd_ide_enable=0, osd_stereo_mix=0;
wire hs_n, vs_n; wire [7:0] red, green, blue;
wire [2:0] mouse_buttons;
wire kbd_mouse_level, kbd_reset, keyboard_ack;
wire [1:0] kbd_mouse_type; wire [7:0] kbd_mouse_data, joystick0, joystick1;
wire midi_in=1; wire midi_out;
wire [7:0] sd_img_mounted, sd_rd_data;
wire [7:0] sd_rd, sd_wr, sd_wr_data;
wire [63:0] sd_img_size; wire [31:0] sd_sector;
wire [8:0] sd_byte_index; wire sd_busy, sd_done, sd_rd_byte_strobe;
// S2 (pin 87 / btn[1]) is active high; an idle low button must release reset.
reg [1:0] button_reset_sync=0;
always @(posedge clk_28m) begin
    if (rst_28m) button_reset_sync<=0;
    else button_reset_sync<={button_reset_sync[0],btn[1]};
end
reg [7:0] warm_reset=255;
always @(posedge clk_28m) begin
    if (rst_28m || button_reset_sync[1] || soft_reset || kbd_reset) warm_reset<=255;
    else if (warm_reset!=0) warm_reset<=warm_reset-1'b1;
end
wire nanomig_reset=!rom_done || |warm_reset;
wire [31:0] debug_words [0:35];
wire [31:0] cpu_debug [0:23];
wire [31:0] cpu_trace [0:3];
wire [8:0] trace_index; wire [31:0] trace_start;
wire [31:0] video_probe;
reg [15:0] debug_hs_count, debug_vs_count;
reg [31:0] debug_color_count, debug_rom_writes;
reg debug_hs, debug_vs, debug_rom_we;
always @(posedge clk_28m) begin
    if (rst_28m) begin
        debug_hs_count<=0; debug_vs_count<=0; debug_color_count<=0;
        debug_rom_writes<=0; debug_hs<=1; debug_vs<=1; debug_rom_we<=0;
    end else begin
        debug_hs<=hs_n; debug_vs<=vs_n; debug_rom_we<=rom_write;
        if (debug_hs && !hs_n) debug_hs_count<=debug_hs_count+1'b1;
        if (debug_vs && !vs_n) debug_vs_count<=debug_vs_count+1'b1;
        if (|{red,green,blue}) debug_color_count<=debug_color_count+1'b1;
        if (rom_write && !debug_rom_we) debug_rom_writes<=debug_rom_writes+1'b1;
    end
end
assign debug_words[0]=32'h414d4405;
assign debug_words[1]={14'b0,warm_reset,btn[1:0],kbd_reset,soft_reset,nanomig_reset,
                      rom_done,sdram_ready,pll_lock,rst_28m,1'b0};
assign debug_words[2]={debug_vs_count,debug_hs_count};
assign debug_words[3]=debug_color_count;
for (genvar d=0;d<24;d=d+1) assign debug_words[4+d]=cpu_debug[d];
assign debug_words[28]=debug_rom_writes;
assign debug_words[29]={5'b0,sdram_cs,sdram_we,sdram_be,sdram_addr,1'b0};
assign debug_words[30]={sdram_dout,sdram_din};
assign debug_words[31]={8'b0,red,green,blue};
for (genvar t=0;t<4;t=t+1) assign debug_words[32+t]=cpu_trace[t];
amiga_link link(.clk(clk_28m),.rst_n(rst_28m_n),.sck(link_sck),.cs_n(link_cs_n),
    .io_in(link_io),.io_out(link_out),.io_oe(link_oe),.clk7_en(clk7_en),.clk7n_en(clk7n_en),
    .audio_left(audio_left),.audio_right(audio_right),.key_free(key_free),.debug_words(debug_words),
    .trace_index(trace_index),.trace_start(trace_start),.video_probe(video_probe),
    .disk_reset(nanomig_reset),.disk_rd(sd_rd),.disk_wr(sd_wr),.disk_sector(sd_sector),
    .disk_mounted(sd_img_mounted),.disk_size(sd_img_size),.disk_busy(sd_busy),.disk_done(sd_done),
    .disk_strobe(sd_rd_byte_strobe),.disk_addr(sd_byte_index),.disk_data(sd_rd_data),
    .hid_strobe(hid_strobe),.hid_start(hid_start),.hid_data(hid_data),.hid_reset(hid_reset),
    .sd_cs_n(SD_CS),.sd_sck(SD_SCK),.sd_mosi(SD_MOSI),.sd_miso(SD_MISO),
    .boot_req(boot_req),.soft_reset(soft_reset),.rom_ready(rom_done),
    .rom_we(rom_write),.rom_addr(rom_address),.rom_word(rom_value));
hid hid(.clk(clk_28m),.reset(rst_28m | hid_reset),.data_in_strobe(hid_strobe),
    .data_in_start(hid_start),.data_in(hid_data),.data_out(),.db9_port(6'b0),.irq(),.iack(1'b1),
    .mouse_buttons(mouse_buttons),.kbd_mouse_level(kbd_mouse_level),.kbd_mouse_type(kbd_mouse_type),
    .kbd_mouse_data(kbd_mouse_data),.keyboard_ack(keyboard_ack),.vsync_n(vs_n),
    .kbd_reset(kbd_reset),.joystick0(joystick0),.joystick1(joystick1),.key_free(key_free));
// Minimig ram/rom interface
wire [23:1] ram_a;
wire [15:0] ram_din;
wire [15:0] ram_dout;
wire 	    ram_we_n;
wire [1:0]  ram_be;
wire 	    ram_oe_n;
wire		ram_refresh;   

wire fastram_sel;
wire [22:1] fastram_addr;
wire fastram_lds;
wire fastram_uds;
wire [15:0] fastram_dout;
wire [15:0] fastram_din;
wire [1:0] fastram_be = {fastram_uds,fastram_lds};  
wire fastram_wr;
wire fastram_ready;
   
wire [15:0] sdram_dout;
wire [47:0] chip48;         // upper 48 bits of 64 bit aligned chipram reads (AGA fmode>0)
wire [47:0] fastram_dout48; // wide read data of the cpu cache port

assign ram_din = sdram_dout;

// pack config values into minimig config
wire [5:0] chipset_config = { 1'b0,osd_chipset,osd_video_mode,1'b0 };
wire [1:0] cpu_config = { |osd_cpu ? 2'b11 : 2'b00 };
wire [7:0] memory_config = { 4'b0_000, osd_slowmem, osd_chipmem };   
wire [2:0] fastram_config = { 1'b0, osd_fastmem };   
wire [2:0] turbo_config = { osd_turbo };
wire [3:0] floppy_config = { osd_floppy_drives, osd_floppy_wrprot, osd_floppy_turbo };
wire [3:0] video_config = { osd_video_filter, osd_video_scanlines };   
// FIXME - setting ide_config[5] prevents minimig from using
// fast chipset bus for GAYLE, which is by default in use
// when 68020 CPU is selected; we may connect fast chip bus
// to GAYLE and set ide_config[5] to 0 to improve performance
wire [5:0] ide_config = { 5'b10000, osd_ide_enable };   
   
nanomig nanomig
(
 .clk_sys(clk_28m),
 .reset(nanomig_reset),
 .por(rst_28m),
 .debug_words(cpu_debug),
 .trace_index(trace_index),.trace_start(trace_start),.trace_words(cpu_trace),

 .clk7_en(clk7_en),
 .clk7n_en(clk7n_en),

 .pwr_led(leds[0]),
 .fdd_led(leds[1]),
 .fdd_step_n(fdd_step_n),
`ifndef DISABLE_IDE
 .hdd_led(leds[2]),
`endif
 
 .memory_config(memory_config),
 .fastram_config(fastram_config),
 .cpu_config(cpu_config),
 .chipset_config(chipset_config),
 .floppy_config(floppy_config),
 .video_config(video_config),
 .turbo_config(turbo_config),
`ifndef DISABLE_IDE
 .ide_config(ide_config),
`endif

 // video
 .hs(hs_n), // horizontal sync
 .vs(vs_n), // vertical sync
 .r(red),
 .g(green),
 .b(blue),

 .audio_left(audio_left),
 .audio_right(audio_right),

 // uart interface 
 .uart_rx(midi_in),
 .uart_tx(midi_out),
`ifdef ENABLE_AT_MODEM
 .serial_status(serial_status),
 .serial_tx_available(serial_tx_available),
 .serial_tx_strobe(serial_tx_strobe),
 .serial_tx_data(serial_tx_data),
 .serial_rx_available(serial_rx_available),
 .serial_rx_strobe(serial_rx_strobe),
 .serial_rx_data(serial_rx_data),
`endif
 
 // keyboard & mouse				 
 .mouse_buttons(mouse_buttons), // mouse buttons
 .kbd_mouse_level(kbd_mouse_level),  
 .kbd_mouse_type(kbd_mouse_type),  
 .kbd_mouse_data(kbd_mouse_data),
 .keyboard_ack(keyboard_ack),
 .joystick0(joystick0),
 .joystick1(joystick1),
				 
 // sd card interface for floppy disk and hdd emulation
 .sdc_img_size(sd_img_size),
 .sdc_img_mounted(sd_img_mounted), 
 .sdc_rd(sd_rd),
 .sdc_wr(sd_wr),
 .sdc_sector(sd_sector),
 .sdc_busy(sd_busy),
 .sdc_done(sd_done), 
 .sdc_byte_in_strobe(sd_rd_byte_strobe),
 .sdc_byte_addr(sd_byte_index),
 .sdc_byte_in_data(sd_rd_data),
 .sdc_byte_out_data(sd_wr_data),
 
 // (s)ram interface
 .ram_data(ram_dout),       // sram data bus
 .ram_address(ram_a),       // sram address bus
 .ramdata_in(ram_din),      // sram data bus in
 ._ram_bhe(ram_be[1]),      // sram upper byte select
 ._ram_ble(ram_be[0]),      // sram lower byte select
 ._ram_we(ram_we_n),        // sram write enable
 ._ram_oe(ram_oe_n),        // sram output enable
`ifdef ENABLE_AGA
 .chip48(chip48),
`else
 .chip48(48'b0),
`endif
 .refresh(ram_refresh),
 
 .fastram_sel(fastram_sel),
 .fastram_addr(fastram_addr),
 .fastram_lds(fastram_lds),
 .fastram_uds(fastram_uds),
 .fastram_dout(fastram_dout),
`ifdef ENABLE_CACHE
 .fastram_dout48(fastram_dout48),
`else
 .fastram_dout48(48'b0),
`endif
 .fastram_din(fastram_din),
 .fastram_wr(fastram_wr),
 .fastram_ready(fastram_ready)
);


wire sdram_sync=clk7_en;
wire sdram_access=(!ram_oe_n || !ram_we_n);
wire minimig_is_accessing_rom=ram_a[22:19]==4'b1111;
wire sdram_cs=rom_done ? sdram_access : rom_write;
wire sdram_refresh=rom_done ? ram_refresh : 1'b0;
wire [15:0] sdram_din=rom_done ? ram_dout : rom_value;
wire [1:0] sdram_be=rom_done ? ram_be : 2'b0;
wire sdram_we=rom_done ? (!ram_we_n && !minimig_is_accessing_rom) : rom_write;
wire [21:0] sdram_addr=rom_done ? ram_a[22:1] : {4'b1111,rom_address};
assign O_sdram_clk = clk_85m_shifted;

localparam CHIP48_BURST = 0
`ifdef ENABLE_AGA
    | 1
`endif
`ifdef ENABLE_CACHE
    | 1
`endif
;

sdram #(
    .DATA_WIDTH(32),
    .RAS_WIDTH(11),
    .CAS_WIDTH(8),
    .SYNC_DELAY(3),               // falling-edge DQ capture preserves return timing
    .CHIP48_BURST(CHIP48_BURST)   // the wide 64 bit fetch AGA or cache needs
) sdram (
	.sd_data    ( IO_sdram_dq   ), // 32 bit bidirectional data bus
	.sd_addr    ( O_sdram_addr  ), // 11 bit multiplexed address bus
	.sd_dqm     ( O_sdram_dqm   ), // two byte masks
	.sd_ba      ( O_sdram_ba    ), // two banks
	.sd_cs      ( O_sdram_cs_n  ), // a single chip select
	.sd_we      ( O_sdram_wen_n ), // write enable
	.sd_ras     ( O_sdram_ras_n ), // row address select
	.sd_cas     ( O_sdram_cas_n ), // columns address select
	.sd_cke     ( O_sdram_cke   ), // SDRAM clock enable

	// cpu/chipset interface
	.clk        ( clk_85m       ), // sdram is accessed at 85MHz
	.reset_n    ( rst_sdram_n   ), // init signal after FPGA config to initialize RAM

	.ready      ( sdram_ready   ), // ram is ready and has been initialized
	.sync       ( sdram_sync    ), // rising edge of sync is begin of a memory cycle
	.refresh    ( sdram_refresh ), // refresh cycle

	.din        ( sdram_din     ), // data input from chipset/cpu
	.dout       ( sdram_dout    ),
	.dout48     ( chip48        ), // wide fetch data for AGA fmode>0
	.addr       ( sdram_addr    ), // 22 bit word address
	.ds         ( sdram_be      ), // upper/lower data strobe
	.cs         ( sdram_cs      ), // cpu/chipset requests read/wrie
	.we         ( sdram_we      ),  // cpu/chipset requests write

	.p2_din        ( fastram_din     ), // data input from chipset/cpu
	.p2_dout       ( fastram_dout    ),
	.p2_dout48     ( fastram_dout48  ), // wide read data for the cache line fills
	.p2_addr       ( fastram_addr    ), // 22 bit word address
	.p2_ds         ( fastram_be      ), // upper/lower data strobe
	.p2_cs         ( fastram_sel     ), // cpu/chipset requests read/wrie
	.p2_we         ( fastram_wr      ),  // cpu/chipset requests write
	.p2_ack        ( fastram_ready   )
);


wire [15:0] silent_audio[1:0];
assign silent_audio[0]=0, silent_audio[1]=0;
wire [2:0] tmds;
wire tmds_clock;

wire vreset, vpal, interlace, short_frame;

video_analyzer video_analyzer (
    .clk         ( clk_28m   ),
    .hs          ( hs_n      ),
    .vs          ( vs_n      ),
    .pal         ( vpal      ),
    .short_frame ( short_frame ),
    .screen      ( osd_video_screen ),
    .interlace   ( interlace ),
    .vreset      ( vreset    )
);

hdmi #(
    .DVI_OUTPUT(1),
    .AUDIO_BIT_WIDTH(16),
    .VENDOR_NAME( { "MiSTle", 16'd0} ),
    .PRODUCT_DESCRIPTION( {"Nanomig", 72'd0} )
) hdmi(
  .clk_pixel_x5(clk_pixel_x5),
  .clk_pixel(clk_pixel),
  .clk_audio(1'b0),
  .audio_sample_word( silent_audio ),
  .tmds(tmds),
  .tmds_clock(tmds_clock),

  .pal_mode(vpal),
  .short_frame ( short_frame ),
  .screen ( osd_video_screen ),
  .interlace(interlace),
  .reset(vreset),    // signal to synchronize HDMI

  .rgb( video_probe[31:24]==8'ha5 ? video_probe[23:0] : { red, green, blue } )
);

// differential output
ELVDS_OBUF tmds_bufds [3:0] (
        .I({tmds_clock, tmds}),
        .O({O_tmds_clk_p, O_tmds_data_p}),
        .OB({O_tmds_clk_n, O_tmds_data_n})
);


endmodule
`default_nettype wire

// SPDX-License-Identifier: Apache-2.0
//
// Ядро видео: темп кадров. Каждый выходной кадр (vtick — начало кадровой синхронизации, уже в
// домене clk) добавляет OUT_US мкс к запасу; слот видео (записанный кадр или пустой чанк —
// повтор) выпускается (go), когда запас дошёл до периода кадра ролика (avih), и запас
// уменьшается на период. Поэтому кадр всегда выпускается сразу после начала выходного кадра,
// и fb_core показывает его с того же кадра: 25 кадров/с на 720p50 — ровно по два выходных
// кадра на кадр, 24 — по два и раз в 12 кадров три. Кадры не пропускаются никогда.
//
// Первый кадр после сброса выпускается сразу — посреди выходного кадра, а виден он с начала
// следующего: поэтому ближайший vtick после него запаса не добавляет, и первый кадр, как все,
// виден целый период. Запас ограничен двумя периодами: если кадр
// опоздал (поток не успел, пауза плеера), следующий выходит сразу, как готов, ещё один — через
// выходной кадр, а дальше темп обычный — без пачки кадров после паузы.
//
// ЧАСЫ ЗВУКА (aclk_en): у ролика со звуком ведущие часы — звук. Приложение ESP пишет время
// проигранного звука от начала потока (aclk_us, мкс; после сброса потока — снова с 0), и слот n
// (с 0) выходит, когда aclk_us ≥ n·период: картинка идёт за звуком, пауза звука — пауза кадров,
// расхождение кварцев ESP и Tang не копится. Первый слот (n = 0) — сразу. Кадр показывается с
// ближайшего выходного кадра (в среднем на 10 мс позже звука — постоянный сдвиг).
//
// ПАУЗА (pause, бит 2 REG_CPURESET от плагина): слоты не выходят, выходные кадры запаса не
// добавляют — кадр на экране стоит сразу (кадры, уже лежащие в FIFO, ждут), после паузы темп
// идёт с того же запаса, без догоняющих кадров.
//
module vp_pace #(
    parameter int OUT_US = 20_000           // выходной кадр, мкс (720p50)
) (
    input  wire        clk,
    input  wire        rst_n,
    input  wire        clr,                 // сброс потока: первый кадр — сразу
    input  wire        vtick,               // импульс: начало выходного кадра
    input  wire        pause,               // пауза плеера: темп стоит
    input  wire [31:0] us_frame,            // мкс на кадр ролика; 0 — как 40 000 (25 кадров/с)
    input  wire        want,                // слот ждёт: кадр записан или пустой чанк
    input  wire        aclk_en,             // часы звука (ESP) вместо выходных кадров
    input  wire [31:0] aclk_us,             //   время проигранного звука с начала потока, мкс
    output reg         go,                  // импульс: выпустить слот
    output reg  [31:0] slots                // выпущено слотов с сброса (время для панели)
);
    // период: 1 000…1 000 000 мкс (меньшее — 1 мс, большее — 1 с, 0 — 40 мс)
    wire [20:0] per = us_frame == 32'd0 ? 21'd40_000 :
                      us_frame < 32'd1_000 ? 21'd1_000 :
                      us_frame > 32'd1_000_000 ? 21'd1_000_000 : us_frame[20:0];
    reg  [21:0] acc;                        // запас, мкс (до двух периодов)
    reg         hold;                       // слот выпущен — ждём, пока want упадёт
    reg         first;                      // первый слот после сброса — без ожидания
    reg         skip;                       // первый слот выпущен: ближайший vtick не в счёт
    wire [21:0] acc_v = (vtick && !skip && !pause) ? acc + 22'(OUT_US) : acc;
    reg  [31:0] due;                        // часы звука: время следующего слота, мкс
    wire        a_due = aclk_us >= due;
    wire [21:0] cap   = {per, 1'b0};

    always_ff @(posedge clk or negedge rst_n) begin
        if (!rst_n) begin
            acc <= '0; hold <= 1'b0; first <= 1'b1; skip <= 1'b0; go <= 1'b0; slots <= '0;
            due <= '0;
        end else if (clr) begin
            acc <= '0; hold <= 1'b0; first <= 1'b1; skip <= 1'b0; go <= 1'b0; slots <= '0;
            due <= '0;
        end else if (aclk_en) begin
            // часы звука
            go <= 1'b0;
            if (!want) hold <= 1'b0;
            if (want && !hold && !pause && a_due) begin
                go    <= 1'b1;
                hold  <= 1'b1;
                first <= 1'b0;
                slots <= slots + 32'd1;
                due   <= due + {11'd0, per};
            end
        end else begin
            go <= 1'b0;
            if (vtick && !pause) skip <= 1'b0;
            if (!want) hold <= 1'b0;
            if (want && !hold && !pause && (first || acc_v >= {1'b0, per})) begin
                go    <= 1'b1;
                hold  <= 1'b1;
                first <= 1'b0;
                if (first) skip <= 1'b1;
                slots <= slots + 32'd1;
                due   <= due + {11'd0, per};
                acc   <= first ? 22'd0 : acc_v - {1'b0, per};
            end else if (!first) begin
                acc <= acc_v > cap ? cap : acc_v;
            end
        end
    end
endmodule

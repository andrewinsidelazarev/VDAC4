// SPDX-License-Identifier: Apache-2.0
//
// RGB-светодиод WS2812 модуля Tang гасится: его DIN — на том же выводе FPGA 79, что и MISO
// FT812 (так разведён модуль, docs/a2-netlist-audit.md, замечание 6). Биты MISO при обмене
// Evo с FT812 светодиод принимает за цвет и держит последний, пока не придёт другой, — и после
// ухода в ядро TS-Config (там MISO — 0) светил им дальше.
//
// Как WS2812 берёт цвет: после сброса (низкий уровень дольше порога — у WS2812 от 50 мкс, у
// WS2812B — от 280 мкс) первые 24 бита — в его регистр, следующие он передаёт дальше (DOUT, здесь
// никуда); показывает регистр он на следующем сбросе. Бит — по длительности высокого уровня
// (0,32 мкс — «0»). MISO вне данных чтения — 0 (ft_spi), так что биты ему дают только чтения Evo.
//
// До 1.38 здесь после 320 мкс без выбора FT812 отдавался один «чёрный» (24 нулевых бита), и
// дальше вывод стоял низким: следующая пауза снова сбрасывала WS2812, первое после неё чтение
// Evo ложилось в регистр, а очередной сброс его показывал. R-Type, который опрашивает FT812 весь
// кадр (REG_DLSWAP, REG_FRAMES), мигал им «ёлкой»; программы с хостом-ESP (MISO — 0) — нет.
//
// С 1.38 — сбросов между посылками нет, а в регистр после каждого сброса первыми идут наши нули
// (low — сколько тактов подряд вывод низкий, need — сколько нулей регистру ещё нужно):
//   тёмный (need = 0, !dirty, !show): пока FT812 не выбран, раз в ~17 мкс (low ≥ 2^10 тактов) — один
//     нулевой бит: сброса нет, биты чтений Evo уходят на DOUT, показан и в регистре — чёрный;
//   low ≥ 2^11 тактов (~34 мкс — меньше порога любой версии; так бывает только внутри посылки, например
//     в записи листа R-Type ~0,37 мс при MISO = 0): сброс возможен — need = 24, и при поднятом
//     FT_CS сразу нули (сбросился — регистр станет чёрным, нет — нули уйдут дальше);
//   бит MISO при need > 0 — регистр мусорный (dirty): ждать сброс наверняка (low ≥ 3·2^13 тактов,
//     ~405 мкс:
//     он покажет мусор), заполнить регистр нулями и ждать ещё один сброс наверняка (show) — он
//     покажет чёрный; после загрузки ядра — так же (цвет неизвестен).
// Пороги — разряды счётчика, а не сравнения с ним (ядро FT812 на пределе по месту): при clk 55…70 МГц
// они в нужных границах (поддержка < 25 мкс, «возможно» 29…37 мкс, «наверняка» > 350 мкс).
// Вывод на шину Evo выходит через U8 только при выбранном FT812 или ESP, так что при поднятом
// FT_CS эти импульсы Evo не видит; опущен FT_CS — на выводе сразу MISO (выбор — по самому выводу,
// без синхронизатора).
module ws_dark #(
    parameter int CLK_KHZ = 61_875
) (
    input  wire clk,
    input  wire rst_n,
    input  wire cs_n,                       // FT_CS_N с вывода
    input  wire miso,                       // MISO FT812 (идёт на вывод при опущенном FT_CS_N)
    output wire pin                         // FPGA 79
);
    localparam int T0H   = CLK_KHZ * 32 / 100_000;  // 0,32 мкс
    localparam int T0L   = CLK_KHZ * 90 / 100_000;  // 0,90 мкс
    localparam int TW    = $clog2(T0L + 1);
    initial if (CLK_KHZ < 55_000 || CLK_KHZ > 70_000) $error("ws_dark: пороги-разряды — для 55…70 МГц");

    reg  [1:0]    cs_s, mi_s;               // FT_CS_N и MISO в домене clk
    reg  [14:0]   low;                      // тактов подряд вывод низкий (до 3·2^13)
    reg           rs1_d, rst_d;             // «возможно» и «наверняка» уже были с последнего высокого
    reg  [4:0]    need;                     // нулей, которые регистр WS2812 ещё возьмёт
    reg           dirty;                    // в регистре может быть не чёрный
    reg           show;                     // регистр чёрный, но показан ли — ждём сброс
    reg           fill;                     // отдавать нули в регистр (иначе need — только учёт)
    reg           run, hi;                  // идёт наш бит; его высокая часть
    reg  [TW-1:0] t;

    always_ff @(posedge clk or negedge rst_n) begin
        if (!rst_n) begin
            cs_s <= 2'b11; mi_s <= 2'b00; low <= '0; need <= '0; dirty <= 1'b1; show <= 1'b0;
            fill <= 1'b0; rs1_d <= 1'b0; rst_d <= 1'b0;
            run <= 1'b0; hi <= 1'b0; t <= '0;
        end else begin
            cs_s <= {cs_s[0], cs_n};
            mi_s <= {mi_s[0], miso};
            // сколько вывод низкий: сброс WS2812 — возможно, затем наверняка
            if (hi || (!cs_s[1] && mi_s[1])) begin
                low <= '0; rs1_d <= 1'b0; rst_d <= 1'b0;
            end else if (!(low[14] && low[13])) low <= low + 1'b1;
            // сброс возможен: регистр, может быть, пуст — следить, чтобы в него не лёг бит MISO; нули
            // отдавать сразу, если не ждём сброс, который покажет чёрный (show)
            if (low[14:11] != 4'd0 && !rs1_d) begin
                rs1_d <= 1'b1;
                if (!dirty) begin need <= 5'd24; fill <= !show; end
            end
            if (low[14] && low[13] && !rst_d) begin
                rst_d <= 1'b1;
                // сброс наверняка, показан регистр: чёрный, если в нём только наши нули (need = 24 —
                // после возможного сброса битов не было: пустой регистр цвета не меняет)
                show  <= dirty || (need != 5'd0 && need != 5'd24);
                dirty <= 1'b0;
                need  <= 5'd24;
                fill  <= 1'b1;
            end

            if (!cs_s[1]) begin
                // FT812 выбран: на выводе MISO; бит MISO, пока регистр не полон нулей, — мусор
                run <= 1'b0; hi <= 1'b0;
                if (mi_s[1] && need != 5'd0) begin need <= 5'd0; dirty <= 1'b1; end
            end else if (run) begin
                // наш нулевой бит: 0,32 мкс высокий, 0,9 мкс низкий
                if (t != '0) t <= t - 1'b1;
                else if (hi) begin
                    hi <= 1'b0;
                    t  <= TW'(T0L - 1);
                end else run <= 1'b0;
            end else if (!dirty && ((fill && need != 5'd0) || (!show && low[14:10] != 5'd0))) begin
                // нуль в регистр или поддерживающий бит (при show — ждём сброс, без битов)
                run <= 1'b1;
                hi  <= 1'b1;
                t   <= TW'(T0H - 1);
                if (need != 5'd0) need <= need - 5'd1;
                if (need == 5'd1) fill <= 1'b0;
            end
        end
    end

    assign pin = cs_n ? hi : miso;
endmodule

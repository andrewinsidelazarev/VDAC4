// SPDX-License-Identifier: Apache-2.0
//
// Деблокер ядра видео: сглаживание окна края блока — одна составляющая цвета (8 бит) восьми точек
// поперёк края: v0…v3 | v4…v7 (половинки соседних блоков 8×8; у уменьшенной картинки — v0 v1 | v2
// v3, блок — 4 точки холста).
//
// Ядро — фильтр низких частот режима «DC offset» MPEG-4 (ISO 14496-2, F.3.1): [1 1 2 2 4 2 2 1 1]/16,
// но за концы окна — нечётное отражение (p[−m] = 2·v0 − v[m], p[7+m] = 2·v7 − v[7−m]) вместо точек
// соседних окон. Так окна соседних краёв не пересекаются (край — через 8 точек, окно — 8), концы
// окна не меняются (стык с соседним окном — без шва), а линейный градиент проходит без изменений:
// фильтр сглаживает ступеньку квантования и не трогает плавный перепад. (Проба 29.10.2026 с
// «пологим скатом» — прибавкой ската от разницы средних половинок — гнула градиенты у краёв блоков,
// и в тёмных заливках проступала решётка линий: пользователь — «видны как бы линии и
// горизонтальные и вертикальные».) Закрытые формулы (×16, одно округление):
//   o0 = v0                                   o7 = v7
//   o1 = 10v0 + 2v1 + v2 + v3 + v4 + v5       o6 — зеркально
//   o2 = 6v0 + v1 + 3v2 + 2v3 + 2v4 + v5 + v6 o5 — зеркально
//   o3 = 3v0 + v1 + 2v2 + 4v3 + 2v4 + 2v5 + v6 + v7   o4 — зеркально
// Здесь — только o0…o3 (дорожки 0…3 выхода): вторую половину окна (o7…o4) вызывающий получает,
// подав окно задом наперёд (сумматоров вдвое меньше; пробная сборка с шестью суммами не
// развелась — ПЛИС заполнена на 99 %).
// Окно 4 (уменьшенная картинка) — [1 2 1]/4 дважды с тем же отражением: o1 = 6v0 + 5v1 + 4v2 + v3,
// o2 — зеркально (окно задом наперёд), o0 и o3 не меняются; дорожки 2, 3 — без изменений.
// Сглаживается только плоское окно (flat — решение вызывающего: размах зелёной окна < 2·QP —
// ступенька от квантования, а не край предмета и не текстура); flat — ко второй ступени, т. е.
// через 2 такта после входа. Веса положительны, сумма 16 — итог в пределах точек окна, насыщение
// не нужно.
//
// Конвейер: вход — регистр вызывающего, здесь две ступени регистров; итог — с выхода второй.
`default_nettype none
module vp_dbk_lp (
    input  wire        clk,
    input  wire        half,             // окно 4 точки (v4…v7 не участвуют)
    input  wire        flat,             // окно плоское — сглаживать (ко второй ступени)
    input  wire [63:0] vin,              // v_i = vin[8i +: 8]
    output reg  [31:0] vout              // o0…o3
);
    wire [11:0] v [0:7];                 // точки, расширенные до 12 бит под суммы
    genvar gi;
    generate for (gi = 0; gi < 8; gi = gi + 1) begin : g_v
        assign v[gi] = {4'd0, vin[8 * gi +: 8]};
    end endgenerate

    // ступень 1: взвешенные суммы
    reg  [11:0] s1, s2, s3;
    reg  [31:0] v1;
    reg         half1;
    always_ff @(posedge clk) begin
        s1  <= half ? (v[0] << 2) + (v[0] << 1) + (v[1] << 2) + v[1] + (v[2] << 2) + v[3]
                    : (v[0] << 3) + ((v[0] + v[1]) << 1) + v[2] + v[3] + v[4] + v[5];
        s2  <= (v[0] << 2) + ((v[0] + v[2]) << 1) + v[1] + v[2] + ((v[3] + v[4]) << 1) + v[5] + v[6];
        s3  <= (v[0] << 1) + v[0] + v[1] + (v[2] << 1) + (v[3] << 2) + ((v[4] + v[5]) << 1) + v[6] + v[7];
        v1    <= vin[31:0];
        half1 <= half;
    end

    // ступень 2: плоское окно — сглаженные точки, иначе прежние
    function automatic [7:0] rnd(input logic [11:0] s);
        logic [11:0] t;
        t = s + 12'd8;
        rnd = t[11:4];
    endfunction
    always_ff @(posedge clk) begin
        vout <= v1;
        if (flat) begin
            vout[15:8] <= rnd(s1);
            if (!half1) begin
                vout[23:16] <= rnd(s2);
                vout[31:24] <= rnd(s3);
            end
        end
    end
endmodule
`default_nettype wire
